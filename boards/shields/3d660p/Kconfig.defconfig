## boards/shields/3d660p/Kconfig.defconfig
```kconfig
if SHIELD_3D660P

# Name must be less than 16 characters long!
config ZMK_KEYBOARD_NAME
    default "3d660p"

endif
```

## boards/shields/3d660p/Kconfig.shield
```kconfig
# No whitespace after the comma or in your keyboard name!
config SHIELD_3D660P
    def_bool $(shields_list_contains,3d660p)
```
